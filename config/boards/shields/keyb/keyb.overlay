/ {
	chosen {
		zmk,kscan = &default_kscan;
	};


	default_kscan: kscan {
		compatible = "zmk,kscan-gpio-direct";

		input-gpios =
            <&gpio0 11 (GPIO_ACTIVE_LOW | GPIO_PULL_UP)>,   // Top-most row
            <&gpio0 12 (GPIO_ACTIVE_LOW | GPIO_PULL_UP)>,
            <&gpio0 24 (GPIO_ACTIVE_LOW | GPIO_PULL_UP)>,
            <&gpio0 25 (GPIO_ACTIVE_LOW | GPIO_PULL_UP)>;
    };
};