## boards/saidalvarado/keyb/Kconfig.keyb
```kconfig
# key_b board configuration

# Copyright (c) 2020 Pete Johanson
# SPDX-License-Identifier: MIT

config BOARD_KEYB
    select SOC_NRF52840_QIAA
    select ZMK_BOARD_COMPAT if BOARD_KEYB_NRF52840_ZMK
    imply RETAINED_MEM if BOARD_KEYB_NRF52840_ZMK
    imply RETENTION if BOARD_KEYB_NRF52840_ZMK
    imply RETENTION_BOOT_MODE if BOARD_KEYB_NRF52840_ZMK
```

## boards/saidalvarado/keyb/board.yml
```yaml
board:
  name: keyb
  vendor: saidalvarado
  socs:
    - name: nrf52840
      variants:
        - name: zmk
```
