## boards/arm/keyb/Kconfig.board
```kconfig
# nice!nano board configuration

# Copyright (c) 2020 Pete Johanson
# SPDX-License-Identifier: MIT

config BOARD_KEYB
    bool "keyb"
    depends on SOC_NRF52840_QIAA
```

## boards/shields/keyb/Kconfig.defconfig
```kconfig
config ZMK_BLE
	default y

config ZMK_USB
	default y

if SHIELD_KEYB

config ZMK_KEYBOARD_NAME
    default "KeyB"

if USB_DEVICE_STACK

config USB_NRFX
    default y

endif # USB_DEVICE_STACK

config BT_CTLR
    default BT

endif
```
